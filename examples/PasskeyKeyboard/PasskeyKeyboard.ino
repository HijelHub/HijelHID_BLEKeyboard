/**
 * PasskeyKeyboard.ino
 *
 * Copyright (c) 2026 Hijel. All rights reserved.
 *
 * Licensed under the Apache License, Version 2.0 (the "License");
 * you may not use this file except in compliance with the License.
 * You may obtain a copy of the License at
 *
 *     https://www.apache.org/licenses/LICENSE-2.0
 *
 * Unless required by applicable law or agreed to in writing, this software
 * is provided "AS IS", WITHOUT WARRANTIES OR CONDITIONS OF ANY KIND, either
 * express or implied. The author(s) accept no liability for any damages,
 * loss, or consequences arising from the use or misuse of this software.
 * See the License for the full terms governing permissions and limitations.
 *
 * ─────────────────────────────────────────────────────────────────────────
 *
 * Demonstrates BLE_KB_SEC_PASSKEY mode with onPassKey() and
 * onPairingComplete() callbacks.
 *
 * When a host tries to pair, a 6-digit passkey is generated and printed
 * to Serial. The user enters it on the host device to complete pairing.
 * Once paired and bonded, the device is remembered and reconnects
 * automatically without asking for the passkey again.
 *
 * To force re-pairing (e.g. to test with a different device), press the
 * BUTTON_PIN for 3 seconds. This clears all stored bonds and
 * restarts advertising.
 *
 *
 */

#include <HijelHID_BLEKeyboard.h>


#define BUTTON_PIN  38   // button — hold to clear bonds | set to your desired GPIO pin


#define BOND_CLEAR_HOLD_MS   3000   // Hold BUTTON_PIN this long to clear bonds
#define DEMO_INTERVAL_MS     10000   // How often to send the demo keystrokes


HijelHID_BLEKeyboard keyboard("Hijel Secure KB", "Hijel", 100);

// Pairing state — set inside callbacks, read in loop()
volatile bool pairingInProgress = false;
volatile bool pairingSuccess    = false;
volatile bool pairingFailed     = false;

// ─────────────────────────────────────────────────────────────────────────
// Callbacks
// ─────────────────────────────────────────────────────────────────────────

/**
 * Fired when a passkey is generated by the library.
 * In a real product you might display this on a screen, flash it in morse
 * code via an LED, or send it over UART to a companion app. Here we just
 * print it prominently to Serial.
 */
void onPassKeyGenerated(uint32_t passkey) {
    pairingInProgress = true;

    Serial.println();
    Serial.println("╔══════════════════════════════╗");
    Serial.printf( "║   PASSKEY:   %06lu           ║\n", (unsigned long)passkey);
    Serial.println("║  Enter this on your device.  ║");
    Serial.println("╚══════════════════════════════╝");
    Serial.println();
}

/**
 * Fired when pairing completes — either successfully or not.
 * success = true  → device is now bonded, reconnects automatically in future.
 * success = false → user likely entered the wrong passkey, or timed out.
 */
void onPairingDone(bool success) {
    pairingInProgress = false;

    if (success) {
        pairingSuccess = true;
        Serial.println("[Security] Pairing successful — device is now bonded.");
        Serial.println("[Security] Future connections will not require a passkey.");
    } else {
        pairingFailed = true;
        Serial.println("[Security] Pairing FAILED — wrong passkey or timeout.");
        Serial.println("[Security] The host will need to try pairing again.");
    }
}

// ─────────────────────────────────────────────────────────────────────────
// Helpers
// ─────────────────────────────────────────────────────────────────────────


// Check if the button has been held long enough to clear bonds
void checkBondClearButton() {
    static uint32_t pressStart  = 0;
    static bool     wasPressed  = false;
    static bool     clearFired  = false;

    bool pressed = (digitalRead(BUTTON_PIN) == LOW);

    if (pressed && !wasPressed) {
        // Button just went down
        pressStart = millis();
        clearFired = false;
        wasPressed = true;
    } else if (!pressed && wasPressed) {
        // Button released
        wasPressed = false;
    } else if (pressed && wasPressed && !clearFired) {
        if (millis() - pressStart >= BOND_CLEAR_HOLD_MS) {
            clearFired = true;
            Serial.println("[Bonds] Clearing all stored bonds...");
            keyboard.clearBonds();
            Serial.println("[Bonds] Done. Re-advertising — pair again with passkey.");
            pairingInProgress = false;
            pairingSuccess    = false;
            pairingFailed     = false;
        }
    }
}

// ─────────────────────────────────────────────────────────────────────────
// setup()
// ─────────────────────────────────────────────────────────────────────────

void setup() {
    Serial.begin(115200);
    delay(500);  // Give Serial time to settle after reset

    Serial.println("\n=== HijelHID Passkey Keyboard Demo ===");

    // Hardware setup
    pinMode(BUTTON_PIN, INPUT_PULLUP);

    // ── Security configuration ───────────────────────────────────────────
    // Must be called before begin().
    keyboard.setSecurityMode(BLEKeyboardSecurity::Passkey);

    // Register the passkey callback — fired when the library generates a
    // 6-digit passkey for the host to enter.
    keyboard.onPassKey(onPassKeyGenerated);

    // Register the pairing completion callback — fired when pairing
    // succeeds or fails.
    keyboard.onPairingComplete(onPairingDone);

    // Optional: enable Normal logging so connection events print to Serial.
    // Use HID_LOG_VERBOSE to also see every HID report sent.
    keyboard.setDebugLevel(HIDLogLevel::Normal);

    // ── Start BLE ────────────────────────────────────────────────────────
    keyboard.begin();

    // Print bond status so the user knows if the device is already paired
    if (keyboard.isBonded()) {
        Serial.println("[Security] A bond exists — will reconnect automatically.");
        Serial.println("[Security] Hold BOOT button 3s to clear bonds and re-pair.");
    } else {
        Serial.println("[Security] No bonds stored — waiting for host to pair.");
        Serial.println("[Security] Open Bluetooth settings and select 'Hijel Secure KB'.");
    }
}

// ─────────────────────────────────────────────────────────────────────────
// loop()
// ─────────────────────────────────────────────────────────────────────────

void loop() {
 
    checkBondClearButton();

    // Print and reset one-shot pairing result flags
    // (Actual work was done inside the callbacks; these just gate Serial output
    //  that needs to run in the main loop context rather than the BLE task.)
    if (pairingSuccess) {
        pairingSuccess = false;
        // Nothing extra needed here — connection proceeds automatically
    }
    if (pairingFailed) {
        pairingFailed = false;
        Serial.println("[Info] Waiting for host to attempt pairing again...");
    }

    // ── Demo keystrokes ──────────────────────────────────────────────────
    // Only send once connected AND fully authenticated.
    // isConnected() returns true as soon as the BLE link is up, but on a
    // passkey-secured device the host may not accept HID reports until
    // encryption is established. In practice NimBLE 2.x queues reports
    // correctly, but the !pairingInProgress guard avoids sending during the
    // passkey entry window when the host UI is occupied.
    static uint32_t lastDemo = 0;

    if (keyboard.isConnected() && !pairingInProgress) {
        if (millis() - lastDemo >= DEMO_INTERVAL_MS) {
            lastDemo = millis();
            
            // open a text editor on the host. you have 10 seconds
            Serial.println("[Demo] Sending keystrokes...");

            // Type a short string
            keyboard.print("Secured via passkey!");
            keyboard.tap(KEY_RETURN);

            // Volume up tap to show media keys work too
            keyboard.tap(MEDIA_VOLUME_UP);
        }
    }
}
